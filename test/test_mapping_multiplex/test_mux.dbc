VERSION ""

NS_ :

BS_:

BU_: Receiver

BO_ 100 MuxMessage: 8 Receiver
 SG_ MuxSelector : 0|8@1+ (1,0) [0|255] "" Receiver
 SG_ AlwaysPresent : 8|8@1+ (1,0) [0|255] "" Receiver

BO_ 200 OtherMessage: 8 Receiver
 SG_ OtherSignal : 0|8@1+ (1,0) [0|255] "" Receiver
